/* source keypos definitions */
//#include "../zmk-nodefree-config/keypos_def/keypos_36keys.h"
#include "zmk-helpers/key-labels/36.h"
// ZMK includes
#include <behaviors.dtsi>
#include <dt-bindings/zmk/keys.h>
#include <dt-bindings/zmk/bt.h>
#include <dt-bindings/zmk/outputs.h>

// Custom includes
//#include "../zmk-nodefree-config/helper.h"
#include "zmk-helpers/helper.h"

#define _BT_SEL_KEYS_ &bt BT_SEL 0 &bt BT_SEL 1 &bt BT_SEL 2 &bt BT_SEL 3 &bt BT_CLR

// LAYERS
#define DEF 0
#define NUM 1
#define FN 2
#define NAV 3
#define CODE 4
#define LANG 5
#define SYS 6
#define MOUSE 7
#define UC 8
#define BLTH 9

#include "combos.dtsi"  // requires layer aliases
#include "extra_keys.h"
#include "mouse.dtsi"   // defines U_MS_* / U_WH_* used by mouse_layer

// KEY ALIASES
#define XXX &none
#define ___ &trans

/* Global settings */

#define QUICK_TAP_MS 175

&sk {  // sticky-key config
    release-after-ms = <600>;  // release after 0.6s
    quick-release;             // no double capitalization when rolling keys
};

&sl {  // sticky-layer config
    ignore-modifiers;          // allow chording sticky mods & layers
};

&lt {  // layer-tap config
    flavor = "balanced";
    tapping-term-ms = <200>;
    quick-tap-ms = <QUICK_TAP_MS>;
};

/* Homerow mods */

#define KEYS_L LT0 LT1 LT2 LT3 LT4 LM0 LM1 LM2 LM3 LM4 LB0 LB1 LB2 LB3 LB4  // left hand
#define KEYS_R RT0 RT1 RT2 RT3 RT4 RM0 RM1 RM2 RM3 RM4 RB0 RB1 RB2 RB3 RB4  // right hand
#define THUMBS LH2 LH1 LH0 RH0 RH1 RH2                                      // thumbs

#define MAKE_HRM(NAME, HOLD, TAP, TRIGGER_POS) \
    ZMK_HOLD_TAP(NAME,  bindings = <HOLD>, <TAP>; flavor = "balanced"; \
        tapping-term-ms = <280>; quick-tap-ms = <QUICK_TAP_MS>;\
        hold-trigger-key-positions = <TRIGGER_POS>; \
        require-prior-idle-ms = <150>; hold-trigger-on-release; \
    )
MAKE_HRM(hml, &kp, &kp, KEYS_R THUMBS)  // left-hand HRMs
MAKE_HRM(hmr, &kp, &kp, KEYS_L THUMBS)  // right-hand HRMs

MAKE_HRM(hmr_lpar_lt, &kp, &lpar_lt, KEYS_L THUMBS)    // used for HRM-combo
MAKE_HRM(hmr_rpar_gt, &kp, &rpar_gt, KEYS_L THUMBS)    // "    "   "   "


// Define mod-morph with a *single* mod trigger for less repetition.
#define SIMPLE_MORPH(NAME, MOD, BINDING1, BINDING2)                            \
  ZMK_MOD_MORPH(NAME, mods = <(MOD_L##MOD | MOD_R##MOD)>;                      \
                bindings = <BINDING1>, <BINDING2>;)

// tap: sticky-shift | shift + tap/ double-tap: caps-word | hold: shift
ZMK_BEHAVIOR(smart_shft, mod_morph,
    bindings = <&sk LSHFT>, <&caps_word>;
    mods = <(MOD_LSFT)>;
)
&caps_word {  // mods deactivate caps-word, requires PR #1441
    /delete-property/ ignore-modifiers;
};

// Tap: left/right parenthesis | Shft + tap: less-than/greater-than.
SIMPLE_MORPH(lpar_lt, SFT, &kp LPAR, &kp LT)
SIMPLE_MORPH(rpar_gt, SFT, &kp RPAR, &kp GT)

// smart-mouse, requires tri-state module. Triggered by the Q+W combo; stays
// active while any mouse-layer key is pressed and toggles off on anything else.
//
// LT4 LT3 are the combo's own keys and must be listed: the tri-state exempts
// only tri_state->position, which for a combo is the combo's virtual position,
// not the physical keys. Without them the Q+W press ends the tri-state on the
// same event that started it. Everything else here is a mouse_layer binding --
// any bound key left out would drop the layer when pressed, clicks included.
ZMK_BEHAVIOR(smart_mouse, tri_state,
    bindings = <&tog MOUSE>, <&none>, <&tog MOUSE>;
    ignored-key-positions = <LT4 LT3 LH2 LH1 RT0 RT1 RT2 RT3 RM0 RM1 RM2 RM3 RB0 RB1 RB2 RB3 RB4 RH0>;
    ignored-layers = <MOUSE NAV FN>;  // holding a speed mode must not cancel
)

/* Nav cluster: tap for the arrow, long-press for home/end/document ends. */

// Trigger tap-action on all interrupts.
#define MT_CORE \
    flavor = "tap-preferred"; \
    tapping-term-ms = <220>; \
    quick-tap-ms = <220>; \
    hold-trigger-key-positions = <0>;

&mt { MT_CORE };

ZMK_HOLD_TAP(mt_home, bindings = <&masked_home>, <&kp>; MT_CORE)
ZMK_HOLD_TAP(mt_end, bindings = <&masked_end>, <&kp>; MT_CORE)

// Mask CTRL on left/right hold to avoid accidental jumps to start/end of doc.
#define MASK_MODS(NAME, MODS, BINDING) \
    ZMK_MOD_MORPH(NAME, bindings = <BINDING>, <BINDING>; mods = <MODS>;)

MASK_MODS(masked_home, (MOD_LCTL), &kp HOME)
MASK_MODS(masked_end,  (MOD_LCTL), &kp END)

#define NAV_LEFT  &mt_home 0   LEFT  // tap: left  | long-tap: start of line
#define NAV_RIGHT &mt_end 0    RIGHT // tap: right | long-tap: end   of line
#define NAV_UP    &mt LC(HOME) UP    // tap: up    | long-tap: start of doc
#define NAV_DOWN  &mt LC(END)  DOWN  // tap: down  | long-tap: end   of doc

/* Custom behaviors */
ZMK_MACRO(clear_tab,
    wait-ms = <10>;
    tap-ms = <10>;
    bindings = <&macro_tap &kp ESC>
             , <&kt LALT>;
)

ZMK_MACRO(delayed_tab,
    wait-ms = <100>;
    tap-ms = <10>;
    bindings = <&none &kp TAB>;
)

ZMK_MACRO(back_tab,
    wait-ms = <100>;
    tap-ms = <10>;
    bindings = <&macro_press &kp LSHFT>
             , <&macro_tap &kp TAB>
             , <&macro_release &kp LSHFT>;
)
// Alt+Tab swapper, requires PR #1366
ZMK_BEHAVIOR(swapper, tri_state,
    bindings = <&kt LALT>, <&delayed_tab>, <&kt LALT>;
    ignored-key-positions = <LT2>;
)

ZMK_HOLD_TAP(lt_swap,
    flavor = "balanced";
    tapping-term-ms = <200>;
    quick-tap-ms = <QUICK_TAP_MS>;
    bindings = <&mo>, <&swapper>;
)


// Sticky layer + sticky shift (workaround for issue #1421)
ZMK_BEHAVIOR(sls, sticky_key,
    release-after-ms = <1000>;
    bindings = <&uc_shift>;
    ignore-modifiers;
)
ZMK_MACRO(uc_shift,
    wait-ms = <0>;
    tap-ms = <1>;
    bindings = <&macro_press &mo UC &kp LSHFT>
             , <&macro_pause_for_release>
             , <&macro_release &mo UC &kp LSHFT>;
)

// Tap: comma | Shift + tap: semicolon | Ctrl + shift + tap: <.
SIMPLE_MORPH(comma_morph, SFT, &kp COMMA, &kp SEMICOLON)
//SIMPLE_MORPH(comma_inner_morph, CTL, &kp SEMICOLON, &kp LESS_THAN)

// Tap: dot | Shift + tap: colon | Ctrl + shift + tap: >.
SIMPLE_MORPH(dot_morph, SFT, &kp DOT, &kp COLON)
//SIMPLE_MORPH(dot_inner_morph, CTL, &kp COLON, &kp GREATER_THAN)

// Tap: qmark | Shift + tap: excl.
SIMPLE_MORPH(qexcl, SFT, &kp QMARK, &kp EXCL)

// workaround for showing windows menu on LG()
ZMK_MACRO(win_lft,
    wait-ms = <0>;
    tap-ms = <1>;
    bindings = <&macro_press &kp LGUI>
             , <&macro_tap &kp LEFT>
             , <&macro_release &kp LGUI>;
)

ZMK_MACRO(win_rght,
    wait-ms = <0>;
    tap-ms = <1>;
    bindings = <&macro_press &kp LGUI>
             , <&macro_tap &kp RIGHT>
             , <&macro_release &kp LGUI>;
)

ZMK_MACRO(vir_desk_lft,
    wait-ms = <0>;
    tap-ms = <1>;
    bindings = <&macro_press &kp LGUI>
			 , <&macro_press &kp LCTRL>
             , <&macro_tap &kp LEFT>
             , <&macro_release &kp LCTRL>
			 , <&macro_release &kp LGUI>;
)

ZMK_MACRO(vir_desk_rght,
    wait-ms = <0>;
    tap-ms = <1>;
    bindings = <&macro_press &kp LGUI>
			 , <&macro_press &kp LCTRL>
             , <&macro_tap &kp RIGHT>
             , <&macro_release &kp LCTRL>
			 , <&macro_release &kp LGUI>;
)

// macro to show AltTab Terminator instead of alt tabbing
ZMK_MACRO(alttab_term,
    wait-ms = <0>;
    tap-ms = <1>;
    bindings = <&macro_press &kp LGUI>
             , <&macro_press &kp LALT>
             , <&macro_tap &kp SPACE>
             , <&macro_release &kp LALT>
             , <&macro_release &kp LGUI>;
)

ZMK_MACRO(rsz_left,
    wait-ms = <0>;
    tap-ms = <1>;
    bindings = <&macro_press &kp LGUI>
             , <&macro_press &kp LSHFT>
             , <&macro_tap &kp F1>
             , <&macro_release &kp LSHFT>
             , <&macro_release &kp LGUI>;
)

ZMK_MACRO(rsz_down,
    wait-ms = <0>;
    tap-ms = <1>;
    bindings = <&macro_press &kp LGUI>
             , <&macro_press &kp LSHFT>
             , <&macro_tap &kp F2>
             , <&macro_release &kp LSHFT>
             , <&macro_release &kp LGUI>;
)

ZMK_MACRO(rsz_right,
    wait-ms = <0>;
    tap-ms = <1>;
    bindings = <&macro_press &kp LGUI>
             , <&macro_press &kp LSHFT>
             , <&macro_tap &kp F3>
             , <&macro_release &kp LSHFT>
             , <&macro_release &kp LGUI>;
)

ZMK_MACRO(rsz_up,
    wait-ms = <0>;
    tap-ms = <1>;
    bindings = <&macro_press &kp LGUI>
             , <&macro_press &kp LSHFT>
             , <&macro_tap &kp F4>
             , <&macro_release &kp LSHFT>
             , <&macro_release &kp LGUI>;
)

// CODING MACROS

// nvim
ZMK_MACRO(vim_save,
    wait-ms = <0>;
    tap-ms = <1>;
    bindings = <&kp ESC &kp COLON &kp W &kp RET>;
)

ZMK_MACRO(vim_quit,
    wait-ms = <0>;
    tap-ms = <1>;
    bindings = <&kp ESC &kp COLON &kp Q &kp RET>;
)

// visual
ZMK_MACRO(vs_expl,
    wait-ms = <0>;
    tap-ms = <1>;
    bindings = <&macro_press &kp LCTRL>
             , <&macro_tap &kp LBKT>
             , <&macro_release &kp LCTRL>
             , <&macro_tap  &kp S>;
)
               

ZMK_LAYER(def_layer,
//  ╭─────────────┬─────────────┬─────────────┬─────────────┬─────────────╮   ╭─────────────┬─────────────┬─────────────┬─────────────┬─────────────╮
      &kp Q         &kp W         &kp E         &kp R         &kp T             &kp Y         &kp U         &kp I         &kp O         &kp SQT
//  ├─────────────┼─────────────┼─────────────┼─────────────┼─────────────┤   ├─────────────┼─────────────┼─────────────┼─────────────┼─────────────┤
      &lt LANG A   &hml LALT S   &hml LSHFT D  &hml LCTRL F  &kp G             &kp H         &hmr LCTRL J  &hmr RSHFT K  &hmr LALT L   &lt LANG P
//  ├─────────────┼─────────────┼─────────────┼─────────────┼─────────────┤   ├─────────────┼─────────────┼─────────────┼─────────────┼─────────────┤
      &hml LGUI Z   &kp X         &kp C         &kp V         &kp B             &kp N         &kp M         &comma_morph  &dot_morph    &qexcl
//  ╰─────────────┼─────────────┼─────────────┼─────────────┼─────────────┤   ├─────────────┼─────────────┼─────────────┼─────────────┼─────────────┤
                                  &mo NAV       &kp TAB       &kp SPACE         &lt FN RET    &lt NUM BSPC  &smart_shft
//                              ╰─────────────┴─────────────┴─────────────╯   ╰─────────────┴─────────────┴─────────────╯
)

ZMK_LAYER(num_layer,
//  ╭─────────────┬─────────────┬─────────────┬─────────────┬─────────────╮   ╭─────────────┬─────────────┬─────────────┬─────────────┬─────────────╮
      ___           &kp N7        &kp N8        &kp N9        ___               ___           ___           ___           ___           ___          
//  ├─────────────┼─────────────┼─────────────┼─────────────┼─────────────┤   ├─────────────┼─────────────┼─────────────┼─────────────┼─────────────┤
      &kp N0        &kp N4        &kp N5        &kp N6        ___               ___           ___           ___           ___           ___
//  ├─────────────┼─────────────┼─────────────┼─────────────┼─────────────┤   ├─────────────┼─────────────┼─────────────┼─────────────┼─────────────┤
      ___           &kp N1        &kp N2        &kp N3        ___               ___           ___           ___           ___           ___          
//  ╰─────────────┼─────────────┼─────────────┼─────────────┼─────────────┤   ├─────────────┼─────────────┼─────────────┴─────────────┼─────────────╯
                                  ___           ___           ___               ___           ___           ___                                                    
//                              ╰─────────────┴─────────────┴─────────────╯   ╰─────────────┴─────────────┼─────────────╯                                          
)

ZMK_LAYER(func_layer,
//  ╭─────────────┬─────────────┬─────────────┬─────────────┬─────────────╮   ╭─────────────┬─────────────┬─────────────┬─────────────┬─────────────╮
      ___           &kp F7        &kp F8        &kp F9        &kp F12           ___           ___           ___           ___           ___          
//  ├─────────────┼─────────────┼─────────────┼─────────────┼─────────────┤   ├─────────────┼─────────────┼─────────────┼─────────────┼─────────────┤
      ___           &kp F4        &kp F5        &kp F6        &kp F11           ___           ___           ___           ___           ___          
//  ├─────────────┼─────────────┼─────────────┼─────────────┼─────────────┤   ├─────────────┼─────────────┼─────────────┼─────────────┼─────────────┤
      ___           &kp F1        &kp F2        &kp F3        &kp F10           ___           ___           ___           ___           ___          
//  ╰─────────────┼─────────────┴─────────────┼─────────────┼─────────────┤   ├─────────────┼─────────────┼─────────────┴─────────────┼─────────────╯
                                  ___           ___           ___               ___           ___           ___
//                              ╰─────────────┴─────────────┴─────────────╯   ╰─────────────┴─────────────┴─────────────╯      
)

ZMK_LAYER(nav_layer,
//  ╭─────────────┬─────────────┬─────────────┬─────────────┬─────────────╮   ╭─────────────┬─────────────┬─────────────┬─────────────┬─────────────╮
      ___           ___           &back_tab     &swapper      &alttab_term      &rsz_left     &rsz_down     &rsz_up       &rsz_right    &kp C_VOL_UP
//  ├─────────────┼─────────────┼─────────────┼─────────────┼─────────────┤   ├─────────────┼─────────────┼─────────────┼─────────────┼─────────────┤
// home row left deliberately clear so the base-layer homerow mods fall
// through: A(lang) S(alt) D(shift) F(ctrl), plus Z(gui) on the row below.
      ___           ___           ___           ___           ___               NAV_LEFT      NAV_DOWN      NAV_UP        NAV_RIGHT     &kp C_VOL_DN
//  ├─────────────┼─────────────┼─────────────┼─────────────┼─────────────┤   ├─────────────┼─────────────┼─────────────┼─────────────┼─────────────┤
      ___           ___          &vir_desk_lft &vir_desk_rght ___               ___           &win_lft      &win_rght     ___           &kp C_PP
//  ╰─────────────┼─────────────┴─────────────┼─────────────┼─────────────┤   ├─────────────┼─────────────┼─────────────┴─────────────┼─────────────╯
                                  ___           ___           ___               ___           ___           ___
//                              ╰─────────────┴─────────────┴─────────────╯   ╰─────────────┴─────────────┴─────────────╯  
)

ZMK_LAYER(code_layer,
//  ╭─────────────┬─────────────┬─────────────┬─────────────┬─────────────╮   ╭─────────────┬─────────────┬─────────────┬─────────────┬─────────────╮
      ___           ___           ___           ___           ___               &vim_quit     &vs_expl      ___           ___           ___          
//  ├─────────────┼─────────────┼─────────────┼─────────────┼─────────────┤   ├─────────────┼─────────────┼─────────────┼─────────────┼─────────────┤
      ___           ___           ___           ___           ___               ___           ___           ___           ___           ___                  
//  ├─────────────┼─────────────┼─────────────┼─────────────┼─────────────┤   ├─────────────┼─────────────┼─────────────┼─────────────┼─────────────┤
      ___           ___           ___           ___           ___               ___           &vim_save     ___           ___           ___               
//  ╰─────────────┼─────────────┴─────────────┼─────────────┼─────────────┤   ├─────────────┼─────────────┼─────────────┴─────────────┼─────────────╯
                                  ___           ___           ___               ___           ___           ___
//                              ╰─────────────┴─────────────┴─────────────╯   ╰─────────────┴─────────────┴─────────────╯      
)

ZMK_LAYER(lang_layer,
//  ╭─────────────┬─────────────┬─────────────┬─────────────┬─────────────╮   ╭─────────────┬─────────────┬─────────────┬─────────────┬─────────────╮
      ___           ___           &kp RA(E)     ___           ___               ___           ___           ___           &kp RA(O)     ___          
//  ├─────────────┼─────────────┼─────────────┼─────────────┼─────────────┤   ├─────────────┼─────────────┼─────────────┼─────────────┼─────────────┤
      &kp RA(A)     &kp RA(S)     ___           ___           ___               ___           ___           ___           &kp RA(L)     ___
//  ├─────────────┼─────────────┼─────────────┼─────────────┼─────────────┤   ├─────────────┼─────────────┼─────────────┼─────────────┼─────────────┤
      &kp RA(Z)     &kp RA(X)     &kp RA(C)     ___           ___               &kp RA(N)     ___           ___           ___           ___
//  ╰─────────────┼─────────────┴─────────────┼─────────────┼─────────────┤   ├─────────────┼─────────────┼─────────────┴─────────────┼─────────────╯
                                  ___           ___           ___               ___           ___           ___
//                              ╰─────────────┴─────────────┴─────────────╯   ╰─────────────┴─────────────┴─────────────╯
)

// Hold NAV (left thumb) + NUM (right thumb) to reach the sys layer.
ZMK_CONDITIONAL_LAYER(sys, NAV NUM, SYS)

// Reset behaviors run on whichever half the key was pressed on, so both
// halves need their own copy -- one key cannot flash the other side.
ZMK_LAYER(sys_layer,
//  ╭─────────────┬─────────────┬─────────────┬─────────────┬─────────────╮   ╭─────────────┬─────────────┬─────────────┬─────────────┬─────────────╮
//                                                                              force output, so BLE can be tested while on USB power
                                 _BT_SEL_KEYS_                                  &out OUT_USB  &out OUT_BLE  ___           ___           ___
//  ├─────────────┼─────────────┼─────────────┼─────────────┼─────────────┤   ├─────────────┼─────────────┼─────────────┼─────────────┼─────────────┤
      ___           ___           ___           ___           &bootloader       &bootloader   ___           ___           ___           ___
//  ├─────────────┼─────────────┼─────────────┼─────────────┼─────────────┤   ├─────────────┼─────────────┼─────────────┼─────────────┼─────────────┤
      ___           ___           ___           ___           &sys_reset        &sys_reset    ___           ___           ___           ___
//  ╰─────────────┼─────────────┴─────────────┼─────────────┼─────────────┤   ├─────────────┼─────────────┼─────────────┴─────────────┼─────────────╯
                                  ___           ___           ___               ___           ___           ___
//                              ╰─────────────┴─────────────┴─────────────╯   ╰─────────────┴─────────────┴─────────────╯
)

// Toggled by the Q+W combo (&smart_mouse), operated entirely with the right
// hand. Any key not listed in smart_mouse's ignored-key-positions exits.
//
// vim layout: cursor is hjkl on the home row, scroll repeats the same four
// columns one row up, buttons sit one row down with back/forward on the
// outer columns. LCLK is repeated on the thumb so it can be held for
// drag-select while the fingers move the cursor.
ZMK_LAYER(mouse_layer,
//  ╭─────────────┬─────────────┬─────────────┬─────────────┬─────────────╮   ╭─────────────┬─────────────┬─────────────┬─────────────┬─────────────╮
      ___           ___           ___           ___           ___               U_WH_L        U_WH_D        U_WH_U        U_WH_R        ___
//  ├─────────────┼─────────────┼─────────────┼─────────────┼─────────────┤   ├─────────────┼─────────────┼─────────────┼─────────────┼─────────────┤
      ___           ___           ___           ___           ___               U_MS_L        U_MS_D        U_MS_U        U_MS_R        ___
//  ├─────────────┼─────────────┼─────────────┼─────────────┼─────────────┤   ├─────────────┼─────────────┼─────────────┼─────────────┼─────────────┤
      ___           ___           ___           ___           ___               &mkp MB4      &mkp LCLK     &mkp MCLK     &mkp RCLK     &mkp MB5
//  ╰─────────────┼─────────────┴─────────────┼─────────────┼─────────────┤   ├─────────────┼─────────────┼─────────────┴─────────────┼─────────────╯
//                              warp (&mo NAV, precision
//                              via fallthrough)
                                  ___           &mo FN        ___               &mkp LCLK     ___           ___
//                              ╰─────────────┴─────────────┴─────────────╯   ╰─────────────┴─────────────┴─────────────╯
)